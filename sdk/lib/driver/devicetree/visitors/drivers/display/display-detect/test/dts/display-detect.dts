// Copyright 2024 The Fuchsia Authors. All rights reserved.
// Use of this source code is governed by a BSD-style license that can be
// found in the LICENSE file.

/dts-v1/;
/ {
    compatible = "fuchsia,test-dt";
    model = "test";
    #address-cells = <2>;
    #size-cells = <2>;

    display_detect: display-detect@1000 {
      reg = <0x0 0x1000 0x0 0x100>;
      #display-detect-cells = <0>;
    };

    hdmi-display {
      compatible = "fuchsia,hdmi-display";
      display-detect = <&display_detect>;
      display-detect-names = "HDMI";
    };
};
