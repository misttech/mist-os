/dts-v1/;

/ {
	#address-cells = <0x02>;
	#size-cells = <0x02>;
	compatible = "fuchsia,sample-dt";

	iommu {
		#iommu-cells = <0x01>;
		phandle = <0x01>;
	};

	sample-bti-device {
		compatible = "fuchsia,sample-bti-device";
		iommus = <0x01 0x02>;
	};

	sample-device@0 {
		compatible = "fuchsia,sample-device";
		reg = <0x00 0xaaaaaaaa 0x00 0x2000 0xfafafafa 0xbbbbbbbb 0x00 0x3000 0x00 0xcccccccc 0x10000010 0x4000>;
	};
};
