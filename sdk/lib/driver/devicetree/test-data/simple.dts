// Copyright 2023 The Fuchsia Authors. All rights reserved.
// Use of this source code is governed by a BSD-style license that can be
// found in the LICENSE file

/dts-v1/;

/ {
    compatible = "fuchsia,sample-dt";
    #address-cells = <2>;
    #size-cells = <2>;

    label: example-device {
        compatible = "fuchsia,sample-device";
    };

    another-device {
        reference = <&label>;
    };

};