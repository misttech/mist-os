/dts-v1/;

/ {
    #address-cells = <1>;
    #size-cells = <1>;
    reserved-memory {
        #address-cells = <1>;
        #size-cells = <1>;
        ranges;
        buffer@78000000 {
            reg = <0x78000000 0x800000>;
        };

        buffer@76000000 {
            reg = <0x76000000 0x400000>;
        };
    };
};