/dts-v1/;

/ {
    #address-cells = <1>;
    #size-cells = <1>;
    memory@40000000 {
        device_type = "memory";
        reg = <0x40000000 0x10000000
                0x50000000 0x20000000>;
    };
    memory@60000000 {
        device_type = "memory";
        reg = <0x60000000 0x30000000
                0x70000000 0x40000000>;
    };
};