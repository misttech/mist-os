// Copyright 2023 The Fuchsia Authors. All rights reserved.
// Use of this source code is governed by a BSD-style license that can be
// found in the LICENSE file.

/dts-v1/;

/include/ "meson-g12-common.dtsi"

/ {
	compatible = "amlogic,a311d";
	#address-cells = <2>;
	#size-cells = <2>;

	canvas: canvas@ff638000{
		compatible = "amlogic,canvas";
		reg = <0x0 0xff638000 0x0 0x2000>;
		iommus = <&dummy_iommu 2>;
	};

	clock: clock-controller@ff63c000 {
		compatible = "amlogic,g12b-clk";
		reg = <0x00 0xff63c000 0x00 0x2000>, <0x00 0xff620000 0x00 0x10000>, <0x00 0xffd18000 0x00 0x1000>;
		#clock-cells = <1>;
	};
}
